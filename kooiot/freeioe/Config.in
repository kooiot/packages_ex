## kooiot/freeioe/Config.in
```kconfig
if PACKAGE_freeioe

config FREEIOE_CLOUD_HOST
	bool
	prompt "Enable cloud host specify"

config FREEIOE_CLOUD_PKG_VER
	int
	default 2
	prompt "Package interface version"
	depends on FREEIOE_CLOUD_HOST

config FREEIOE_CLOUD_HOST_ADDR
	string
	default iot.kooiot.com
	prompt "Freeioe Cloud Host"
	depends on FREEIOE_CLOUD_HOST

config FREEIOE_CLOUD_PKG_URL
	string
	default iot.kooiot.com
	prompt "Freeioe PKG URL"
	depends on FREEIOE_CLOUD_HOST

endif
```

## network/strongswan-gmalg/Config.in
```kconfig
if PACKAGE_strongswangmalg
comment "Configuration"

# --with-routing-table
config STRONGSWANGMALG_ROUTING_TABLE
	string
	prompt "Set the IPsec routing table ID"
	default "220"

#  --with-routing-table-prio
config STRONGSWANGMALG_ROUTING_TABLE_PRIO
	string
	prompt "Set the IPsec routing table priority"
	default "220"

comment "Packages"

endif
```
